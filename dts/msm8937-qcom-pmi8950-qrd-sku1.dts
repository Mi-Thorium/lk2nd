// SPDX-License-Identifier: GPL-2.0-only

/dts-v1/;

/include/ "msm8952.dtsi"

/ {
	// This is used by the bootloader to find the correct DTB
	qcom,msm-id = <294 0x0>;
	qcom,board-id = <0x3000b 0>;

	model = "Qualcomm Technologies, Inc. MSM8937-PMI8950 QRD SKU1 DVT1";
	compatible = "qcom,msm8937-pmi8950-qrd-sku1", "qcom,msm8937", "lk2nd,device";
};
