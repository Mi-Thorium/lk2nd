// SPDX-License-Identifier: GPL-2.0-only

/dts-v1/;

/include/ "msm8953.dtsi"

/ {
	// This is used by the bootloader to find the correct DTB
	qcom,msm-id = <293 0x0>;
	qcom,board-id = <26 0>;
	qcom,pmic-id = <0x010016 0x010011 0x0 0x0>;

	model = "Xiaomi Mi Max 2 (oxygen)";
	compatible = "xiaomi,oxygen", "qcom,msm8953", "lk2nd,device";
};
