// SPDX-License-Identifier: GPL-2.0-only

/dts-v1/;

/include/ "msm8952.dtsi"

/ {
	// This is used by the bootloader to find the correct DTB
	qcom,msm-id = <294 0x0>;
	qcom,board-id= <0x1000b 1>, <0x2000b 1>;

	model = "Xiaomi Redmi 3S / 3X (land)";
	compatible = "xiaomi,land", "qcom,msm8937", "lk2nd,device";

	// Bootloader won't continue if it can't delete some nodes from below
	soc {
		#address-cells = <1>;
		#size-cells = <1>;
		ranges = <0x0 0x0 0x0 0xffffffff>;
	};
};
