// SPDX-License-Identifier: GPL-2.0-only

/include/ "msm8952.dtsi"
/include/ "motorola-carrier-channel-ids.dtsi"

/ {
	// This is used by the bootloader to find the correct DTB
	qcom,msm-id = <294 0x0>;

	model = "Moto G (5S) (montana)";
	compatible = "motorola,montana", "qcom,msm8937", "lk2nd,device";
	motorola,device = "montana";
	lk2nd,motorola-unitinfo = <1>;
	lk2nd,pstore = <0xae000000 0x80000>;
};
